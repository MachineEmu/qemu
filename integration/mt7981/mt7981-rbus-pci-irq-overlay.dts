/dts-v1/;
/plugin/;

/* Diagnostic overlay for the supplied U6+ DTB.  The vendor RBUS endpoint is
 * discovered as PCI 00:00.0, but the original DT leaves the PCI host's
 * runtime map_irq callback unset.  Route the four legacy INTx pins directly
 * to the WBSYS GIC SPIs used by the board. */
&{/wbsys@18000000} {
	device_type = "pci";
	#address-cells = <3>;
	#size-cells = <2>;
	bus-range = <0x00 0xff>;
	ranges = <0x82000000 0x00 0x20000000 0x00 0x20000000 0x00 0x10000000>;
	#interrupt-cells = <1>;
	linux,pci-domain = <4>;
	interrupt-parent = <0x01>;
	interrupt-map-mask = <0x0000 0x00 0x00 0x07>;
	interrupt-map = <
		0x0000 0x00 0x00 0x01 0x01 0x00 0xd5 0x04
		0x0000 0x00 0x00 0x02 0x01 0x00 0xd6 0x04
		0x0000 0x00 0x00 0x03 0x01 0x00 0xd7 0x04
		0x0000 0x00 0x00 0x04 0x01 0x00 0xd8 0x04
	>;
};
