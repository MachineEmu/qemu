/dts-v1/;
/plugin/;

/*
 * Compatibility experiment for the supplied U6+ DTB.  WBSYS exposes an
 * ECAM-like config window at 0x18000000, which QEMU models directly.  Using
 * the generic host driver isolates the missing vendor mt_rbus map_irq hook
 * while preserving the real endpoint and DT interrupt map.
 */
&{/wbsys@18000000} {
	compatible = "pci-host-ecam-generic";
	device_type = "pci";
	#address-cells = <3>;
	#size-cells = <2>;
	bus-range = <0x00 0xff>;
	ranges = <0x82000000 0x00 0x20000000 0x00 0x20000000 0x00 0x10000000>;
	#interrupt-cells = <1>;
	linux,pci-domain = <4>;
	interrupt-parent = <0x01>;
	interrupt-map-mask = <0x0000 0x00 0x00 0x07>;
	interrupt-map = <
		0x0000 0x00 0x00 0x01 0x01 0x00 0xd5 0x04
		0x0000 0x00 0x00 0x02 0x01 0x00 0xd6 0x04
		0x0000 0x00 0x00 0x03 0x01 0x00 0xd7 0x04
		0x0000 0x00 0x00 0x04 0x01 0x00 0xd8 0x04
	>;
};
